## config/boards/shields/corne/Kconfig.defconfig
```kconfig
if SHIELD_CORNE_DONGLE

config ZMK_KEYBOARD_NAME
    default "Corne Dongle"

config ZMK_SPLIT_ROLE_CENTRAL
    default y

config ZMK_SPLIT
    default y

config ZMK_SPLIT_BLE_CENTRAL_PERIPHERALS
    default 2

config BT_MAX_CONN
    default 7

config BT_MAX_PAIRED
    default 7

config ZMK_DISPLAY
	default y

config ZMK_WIDGET_WPM_STATUS
    default y

if ZMK_DISPLAY

config I2C
    default y

config SSD1306
    default y

# Add these lines for Bongo Cat
config LV_USE_ANIMATION
    bool
    default y

config ZMK_WIDGET_BONGO_CAT
    bool
    default y
    select LV_USE_IMG
    select LV_USE_ANIMATION
    
endif # ZMK_DISPLAY

if LVGL

config LV_Z_VDB_SIZE
    default 64

config LV_DPI_DEF
    default 148

config LV_Z_BITS_PER_PIXEL
    default 1

choice LV_COLOR_DEPTH
    default LV_COLOR_DEPTH_1
endchoice

config LV_USE_LABEL
    default y

endif # LVGL

endif

if SHIELD_CORNE_LEFT || SHIELD_CORNE_RIGHT

config ZMK_DISPLAY
	default y

config ZMK_WIDGET_BATTERY_STATUS
    default y

config ZMK_WIDGET_BATTERY_STATUS_SHOW_PERCENTAGE
    default y

config ZMK_WIDGET_BONGO_CAT
    default y

config ZMK_IDLE_TIMEOUT
    default 1200000

config ZMK_SLEEP
    default y

config ZMK_IDLE_SLEEP_TIMEOUT
    default 6000000
	
endif
```

## config/boards/shields/corne/Kconfig.shield
```kconfig
# No whitespace after the comma or in the keyboard name!
# Copyright (c) 2020 The ZMK Contributors
# SPDX-License-Identifier: MIT

config SHIELD_CORNE_LEFT
	def_bool $(shields_list_contains,corne_left)

config SHIELD_CORNE_RIGHT
	def_bool $(shields_list_contains,corne_right)

config SHIELD_CORNE_DONGLE
	def_bool $(shields_list_contains,corne_dongle)
```
