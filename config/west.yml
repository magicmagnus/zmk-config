## config/west.yml
```yaml
manifest:
  defaults:
    revision: v0.2
  remotes:
    - name: zmkfirmware
      url-base: https://github.com/zmkfirmware
    - name: urob                      # NEW: where zmk-helpers lives
      url-base: https://github.com/urob
    # Additional modules containing boards/shields/custom code can be listed here as well
    # See https://docs.zephyrproject.org/3.2.0/develop/west/manifest.html#projects
  projects:
    - name: zmk
      remote: zmkfirmware
      revision: v0.2
      import: app/west.yml
    - name: zmk-helpers               # NEW: the helper macros
      remote: urob
      revision: v0.2                  # match ZMK: main <-> main, v0.3 <-> v0.3
  self:
    path: config
```
